/*
 * Copyright (c) 2021 The ZMK Contributors
 *
 * SPDX-License-Identifier: MIT
 */

#include "j46kcols.dtsi"

&kscan0{
    col-gpios
			= <&pro_micro 0 (GPIO_ACTIVE_HIGH)>
			, <&pro_micro 2 (GPIO_ACTIVE_HIGH)>
			, <&pro_micro 3 (GPIO_ACTIVE_HIGH)>
			, <&pro_micro 4 (GPIO_ACTIVE_HIGH)>
			, <&pro_micro 5 (GPIO_ACTIVE_HIGH)>
			, <&pro_micro 8 (GPIO_ACTIVE_HIGH)>
			;
};