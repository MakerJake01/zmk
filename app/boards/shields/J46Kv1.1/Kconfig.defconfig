## app/boards/shields/J46Kv1.1/Kconfig.defconfig
```kconfig
# Copyright (c) 2021 The ZMK Contributors 
# SPDX-License-Identifier: MIT 

if SHIELD_j46kv1.1

config ZMK_KEYBOARD_NAME
	default "J46Kv1.1"

endif
```

## app/boards/shields/J46Kv1.1/Kconfig.shield
```kconfig
# Copyright (c) 2021 The ZMK Contributors
# SPDX-License-Identifier: MIT

config SHIELD_j46kv1.1
	def_bool $(shields_list_contains,j46kv1.1)
```

## app/boards/shields/J46Kv1/Kconfig.defconfig
```kconfig
# Copyright (c) 2021 The ZMK Contributors 
# SPDX-License-Identifier: MIT 

if SHIELD_j46kv1

config ZMK_KEYBOARD_NAME
	default "J46Kv1"

endif
```

## app/boards/shields/J46Kv2/Kconfig.defconfig
```kconfig
# Copyright (c) 2021 The ZMK Contributors 
# SPDX-License-Identifier: MIT 

if SHIELD_j46kv2

config ZMK_KEYBOARD_NAME
	default "J46Kv2"

endif
```

## app/boards/shields/babyvble/Kconfig.defconfig
```kconfig
# Copyright (c) 2021 The ZMK Contributors 
# SPDX-License-Identifier: MIT 

if SHIELD_BABYVBLE

config ZMK_KEYBOARD_NAME
	default "BabyvBle"

endif

CONFIG_ZMK_RGB_UNDERGLOW=y
# Use the STRIP config specific to the LEDs you're using
CONFIG_WS2812_STRIP=y
```

## app/boards/shields/j46kcols/Kconfig.defconfig
```kconfig
# Copyright (c) 2021 The ZMK Contributors
# SPDX-License-Identifier: MIT

if SHIELD_J46KCols_LEFT

config ZMK_KEYBOARD_NAME
	default "J46K-ColS"

config ZMK_SPLIT_BLE_ROLE_CENTRAL
	default y

endif

if SHIELD_J46KXIAO_LEFT || SHIELD_J46KXIAO_RIGHT

config ZMK_SPLIT
	default y

endif
```

## app/boards/shields/j46kcols/Kconfig.shield
```kconfig
# Copyright (c) 2021 The ZMK Contributors
# SPDX-License-Identifier: MIT

config SHIELD_J46KCOLS_LEFT
	def_bool $(shields_list_contains,j46kcols_left)

config SHIELD_J46KCOLS_RIGHT
	def_bool $(shields_list_contains,j46kcols_right)
```

## app/boards/shields/j46kxiao/Kconfig.defconfig
```kconfig
# Copyright (c) 2021 The ZMK Contributors
# SPDX-License-Identifier: MIT

if SHIELD_J46KXIAO_LEFT

config ZMK_KEYBOARD_NAME
	default "J46K-Xiao"

config ZMK_SPLIT_BLE_ROLE_CENTRAL
	default y

endif

if SHIELD_J46KXIAO_LEFT || SHIELD_J46KXIAO_RIGHT

config ZMK_SPLIT
	default y

endif
```

## app/boards/shields/j46kxiao/Kconfig.shield
```kconfig
# Copyright (c) 2021 The ZMK Contributors
# SPDX-License-Identifier: MIT

config SHIELD_J46KXIAO_LEFT
	def_bool $(shields_list_contains,j46kxiao_left)

config SHIELD_J46KXIAO_RIGHT
	def_bool $(shields_list_contains,j46kxiao_right)
```

## app/boards/shields/j4k/Kconfig.defconfig
```kconfig
# Copyright (c) 2021 The ZMK Contributors
# SPDX-License-Identifier: MIT

if SHIELD_J4K

config ZMK_KEYBOARD_NAME
	default "j4k"

endif
```

## app/boards/shields/j4k/Kconfig.shield
```kconfig
# Copyright (c) 2021 The ZMK Contributors
# SPDX-License-Identifier: MIT

config SHIELD_J4K
	def_bool $(shields_list_contains,j4k)
```
